## dts/bindings/aerospace,perovskite-array.yaml
```yaml
description: Perovskite solar cell array payload

compatible: "aerospace,perovskite-array"
include: base.yaml

child-binding:
  properties:
    io-channels:
      type: phandle-array
      required: true
```
