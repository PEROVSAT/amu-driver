## dts/bindings/aerospace,amu.yaml
```yaml
description: AMU device driver

compatible: "aerospace,amu"

# FILL IN when bringing up hardware, e.g.:
#   include: i2c-device.yaml
#   on-bus: i2c

properties:
  amu-type:
    type: int
    description: Sweep type byte written to the AMU config register.

  amu-delay:
    type: int
    description: Inter-point delay value written to the AMU config register.

  amu-ratio:
    type: int
    description: Ratio value written to the AMU config register.

  amu-power:
    type: int
    description: Power value written to the AMU config register.

  amu-dac-gain:
    type: int
    description: DAC gain written to the AMU config register.

  amu-sweep-averages:
    type: int
    description: Number of sweep averages written to the AMU config register.

  amu-adc-averages:
    type: int
    description: Number of ADC averages written to the AMU config register.

  amu-am0-mw:
    type: int
    description: >
      AM0 reference irradiance in mW/m² (e.g. 1366100 for 1366.1 W/m²).
      The driver divides this by 1000.0 before writing to the hardware register.

  amu-area-ucm2:
    type: int
    description: >
      Solar cell area in µcm² (e.g. 10000 for 1.0 cm²).
      The driver divides this by 10000.0 before writing to the hardware register.
```

## src/Kconfig
```kconfig
config PEROVSAT_AMU
	bool "AMU driver"
	depends on DT_HAS_AEROSPACE_AMU_ENABLED
	help
	  Enable the AMU Zephyr driver module.

if PEROVSAT_AMU

choice
	prompt "AMU backend"
	default PEROVSAT_AMU_BACKEND_PUBLIC_MOCK

config PEROVSAT_AMU_BACKEND_HARDWARE
	bool "Hardware (real device over bus)"
	select I2C
	help
	  Link lib/amu.c with src/hardware_transfer.c.

config PEROVSAT_AMU_BACKEND_LIBRARY_MOCK
	bool "Library mock (lib/ without hardware)"
	help
	  Link lib/amu.c with src/lib_mock_transfer.c.

config PEROVSAT_AMU_BACKEND_PUBLIC_MOCK
	bool "Public mock (hardcoded data, no library required)"
	help
	  Link mock/amu.c instead of lib/amu.c.
	  Safe for CI and repos without NDA library access.

endchoice

endif
```

## tests/unit/testcase.yaml
```yaml
tests:
  amu-driver.unit:
    tags:
      - drivers
    platform_allow:
      - qemu_cortex_m3
```
